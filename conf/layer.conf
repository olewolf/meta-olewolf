## conf/layer.conf
```bitbake
# We have a conf and classes directory, append to BBPATH
BBPATH .= ":${LAYERDIR}"

# We have a recipes directory, add to BBFILES
BBFILES += "${LAYERDIR}/recipes*/*/*.bb ${LAYERDIR}/recipes*/*/*.bbappend"

BBFILE_COLLECTIONS += "meta-olewolf"
BBFILE_PATTERN_meta-olewolf := "^${LAYERDIR}/"
BBFILE_PRIORITY_meta-olewolf = "10"

#PREFERRED_PROVIDER_virtual/kernel = "linux-yocto-custom"
PREFERRED_PROVIDERS += " \
	glibc:eglibc \
	eglibc:eglibc \
	libevent:libevent \
	virtual/kernel:linux-yocto-custom \
	ssh:dropbear \
"
```
